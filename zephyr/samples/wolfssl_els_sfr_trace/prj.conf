## CMakeLists.txt
```
cmake_minimum_required(VERSION 3.20.0)
find_package(Zephyr REQUIRED HINTS $ENV{ZEPHYR_BASE})
project(els_sfr_trace)

target_sources(app PRIVATE src/main.c src/els_trace.c)

# Interpose on every ELS register access inside the vendor library. All of them
# go through six macros in one header, so redefining those is enough and no NXP
# file is edited.
target_compile_options(McuxElsPkc PRIVATE
    -include ${CMAKE_CURRENT_SOURCE_DIR}/src/els_sfr_trace.h)
target_include_directories(McuxElsPkc PRIVATE ${CMAKE_CURRENT_SOURCE_DIR}/src)
```

## prj.conf
```kconfig
CONFIG_MCUX_ELS_PKC=y
CONFIG_WOLFSSL=y
CONFIG_WOLFSSL_BUILTIN=y
CONFIG_WOLFSSL_CRYPTO_ONLY=y
CONFIG_WOLFSSL_ELS_PKC=y
CONFIG_MAIN_STACK_SIZE=49152
CONFIG_PRINTK=y
CONFIG_POSIX_SYSTEM_INTERFACES=y
CONFIG_POSIX_TIMERS=y
CONFIG_ENTROPY_GENERATOR=y
CONFIG_WOLFSSL_RSA=y
CONFIG_WOLFSSL_CURVE25519=y
CONFIG_WOLFSSL_ECC_384=y
CONFIG_WOLFSSL_ECC_521=y
CONFIG_WOLFSSL_ECC_512=y
CONFIG_WOLFSSL_ECC_BRAINPOOL=y
```

## src/main.c
```c
/* Drive three ELS operations and record every register access CLNS makes, so
 * the sequence can be diffed against the emulator's for the same work. */
#include <zephyr/kernel.h>

#include <wolfssl/wolfcrypt/settings.h>
#include <wolfssl/wolfcrypt/sha256.h>
#include <wolfssl/wolfcrypt/aes.h>
#include <wolfssl/wolfcrypt/cmac.h>
#include <wolfssl/wolfcrypt/curve25519.h>
#include <wolfssl/wolfcrypt/random.h>
#include <wolfssl/wolfcrypt/port/nxp/els_pkc_port.h>

#include "els_trace.h"

static const byte key16[16] = {
    0x2B,0x7E,0x15,0x16,0x28,0xAE,0xD2,0xA6,
    0xAB,0xF7,0x15,0x88,0x09,0xCF,0x4F,0x3C
};
static const byte iv16[16] = { 0,1,2,3,4,5,6,7,8,9,10,11,12,13,14,15 };
static byte msg[32];
static byte out[32];
static byte digest[WC_SHA256_DIGEST_SIZE];
static byte tag[16];

int main(void)
{
    wc_Sha256 sha;
    Aes aes;
    Cmac cmac;
    word32 tagSz = sizeof(tag);
    int i;

    for (i = 0; i < (int)sizeof(msg); ++i) {
        msg[i] = (byte)(0xF0 ^ i);
    }

    if (wolfCrypt_Init() != 0) {
        printk("wolfCrypt_Init failed\n");
        return 0;
    }
    if (wc_ElsPkc_Init() != 0) {
        printk("wc_ElsPkc_Init failed\n");
        return 0;
    }

    els_trace_arm(1);

    els_trace_mark("sha256-abc");
    if (wc_InitSha256_ex(&sha, NULL, WOLFSSL_ELS_PKC_DEVID) == 0) {
        (void)wc_Sha256Update(&sha, (const byte *)"abc", 3);
        (void)wc_Sha256Final(&sha, digest);
        wc_Sha256Free(&sha);
    }

    els_trace_mark("aes128-cbc-encrypt-32");
    if (wc_AesInit(&aes, NULL, WOLFSSL_ELS_PKC_DEVID) == 0) {
        if (wc_AesSetKey(&aes, key16, 16, iv16, AES_ENCRYPTION) == 0) {
            (void)wc_AesCbcEncrypt(&aes, out, msg, sizeof(msg));
        }
        wc_AesFree(&aes);
    }

    els_trace_mark("cmac-aes128-32");
    if (wc_InitCmac_ex(&cmac, key16, 16, WC_CMAC_AES, NULL, NULL,
                       WOLFSSL_ELS_PKC_DEVID) == 0) {
        (void)wc_CmacUpdate(&cmac, msg, sizeof(msg));
        (void)wc_CmacFinal(&cmac, tag, &tagSz);
    }

    /* X25519 runs on the PKC, which has its own register file and its own
     * unpublished calculation modes. */
    {
        WC_RNG rng;
        static curve25519_key ka, kb;
        static byte shared[32];
        word32 sharedSz = sizeof(shared);

        if (wc_InitRng_ex(&rng, NULL, WOLFSSL_ELS_PKC_DEVID) == 0) {
            els_trace_mark("x25519-keygen");
            if (wc_curve25519_init_ex(&ka, NULL, WOLFSSL_ELS_PKC_DEVID) == 0 &&
                wc_curve25519_init_ex(&kb, NULL, WOLFSSL_ELS_PKC_DEVID) == 0 &&
                wc_curve25519_make_key(&rng, 32, &ka) == 0 &&
                wc_curve25519_make_key(&rng, 32, &kb) == 0) {

                /* the agreement is the step this port offloads */
                els_trace_mark("x25519-agree");
                (void)wc_curve25519_shared_secret(&ka, &kb, shared, &sharedSz);
                wc_curve25519_free(&ka);
                wc_curve25519_free(&kb);
            }
            (void)wc_FreeRng(&rng);
        }
    }

    els_trace_mark("done");
    els_trace_arm(0);

    els_trace_dump();
    return 0;
}
```

## src/els_sfr_trace.h
```c
/* Log every ELS SFR access CLNS makes, so a trace from silicon can be compared
 * against the emulator's. Pulled in with -include, ahead of everything: the
 * real definitions come first and are then replaced, which the include guard
 * makes safe. */
#ifndef ELS_SFR_TRACE_H
#define ELS_SFR_TRACE_H

#include <internal/mcuxClEls_SfrAccess.h>
#include <stdint.h>

void els_trace_rec(char op, const char *name, uint32_t val);

static inline uint32_t els_trace_rd(const char *name, uint32_t v)
{
    els_trace_rec('R', name, v);
    return v;
}

static inline uint32_t els_trace_pkc_rd(const char *name, uint32_t v)
{
    els_trace_rec('Q', name, v);
    return v;
}

/* MCUXCLELS_SFR_READ is deliberately left alone. CLNS takes its address to
 * walk the key store window as an array
 * (mcuxClEls_KeyManagement.c: &MCUXCLELS_SFR_READ(ELS_KS0))[keyIdx]), so it
 * has to stay an lvalue naming the register. Status polling still shows up
 * through BITREAD below. */

#undef MCUXCLELS_SFR_WRITE
#define MCUXCLELS_SFR_WRITE(sfr, value) \
    do { \
        uint32_t _v = (uint32_t)(value); \
        els_trace_rec('W', #sfr, _v); \
        ELS_SFR_BASE->ELS_SFR_NAME(sfr) = _v; \
    } while (0)

#undef MCUXCLELS_SFR_BITREAD
#define MCUXCLELS_SFR_BITREAD(sfr, bit) \
    ((els_trace_rd(#sfr, ELS_SFR_BASE->ELS_SFR_NAME(sfr)) \
      & MCUXCLELS_SFR_FIELD_MASK(sfr, bit)) \
     >> MCUXCLELS_SFR_FIELD_SHIFT(sfr, bit))

#undef MCUXCLELS_SFR_BITSET
#define MCUXCLELS_SFR_BITSET(sfr, bit) \
    do { \
        uint32_t _v = ELS_SFR_BASE->ELS_SFR_NAME(sfr) \
                      | MCUXCLELS_SFR_FIELD_MASK(sfr, bit); \
        els_trace_rec('W', #sfr, _v); \
        ELS_SFR_BASE->ELS_SFR_NAME(sfr) = _v; \
    } while (0)

#undef MCUXCLELS_SFR_BITCLEAR
#define MCUXCLELS_SFR_BITCLEAR(sfr, bit) \
    do { \
        uint32_t _v = ELS_SFR_BASE->ELS_SFR_NAME(sfr) \
                      & (~(uint32_t)MCUXCLELS_SFR_FIELD_MASK(sfr, bit)); \
        els_trace_rec('W', #sfr, _v); \
        ELS_SFR_BASE->ELS_SFR_NAME(sfr) = _v; \
    } while (0)

#undef MCUXCLELS_SFR_BITVALSET
#define MCUXCLELS_SFR_BITVALSET(sfr, bit, val) \
    do { \
        uint32_t _t = ELS_SFR_BASE->ELS_SFR_NAME(sfr) \
                      & (~(uint32_t)MCUXCLELS_SFR_FIELD_MASK(sfr, bit)); \
        uint32_t _v = _t | (((val) << MCUXCLELS_SFR_FIELD_SHIFT(sfr, bit)) \
                            & MCUXCLELS_SFR_FIELD_MASK(sfr, bit)); \
        els_trace_rec('W', #sfr, _v); \
        ELS_SFR_BASE->ELS_SFR_NAME(sfr) = _v; \
    } while (0)

/* The PKC has the same six-macro shape behind PKC_SFR_BASE, and its
 * calculation modes are no more published than the ELS command numbers, so it
 * is traced the same way. MCUXCLPKC_SFR_READ is left alone for the same reason
 * as its ELS counterpart. */
#include <internal/mcuxClPkc_SfrAccess.h>

#undef MCUXCLPKC_SFR_WRITE
#define MCUXCLPKC_SFR_WRITE(sfr, value) \
    do { \
        uint32_t _v = (uint32_t)(value); \
        els_trace_rec('P', #sfr, _v); \
        PKC_SFR_BASE->PKC_SFR_NAME(sfr) = _v; \
    } while (0)

#undef MCUXCLPKC_SFR_BITREAD
#define MCUXCLPKC_SFR_BITREAD(sfr, bit) \
    ((els_trace_pkc_rd(#sfr, PKC_SFR_BASE->PKC_SFR_NAME(sfr)) \
      & MCUXCLPKC_SFR_BITMSK(sfr, bit)) >> MCUXCLPKC_SFR_BITPOS(sfr, bit))

#undef MCUXCLPKC_SFR_BITSET
#define MCUXCLPKC_SFR_BITSET(sfr, bit) \
    do { \
        uint32_t _v = PKC_SFR_BASE->PKC_SFR_NAME(sfr) \
                      | MCUXCLPKC_SFR_BITMSK(sfr, bit); \
        els_trace_rec('P', #sfr, _v); \
        PKC_SFR_BASE->PKC_SFR_NAME(sfr) = _v; \
    } while (0)

#undef MCUXCLPKC_SFR_BITCLEAR
#define MCUXCLPKC_SFR_BITCLEAR(sfr, bit) \
    do { \
        uint32_t _v = PKC_SFR_BASE->PKC_SFR_NAME(sfr) \
                      & (~(uint32_t)MCUXCLPKC_SFR_BITMSK(sfr, bit)); \
        els_trace_rec('P', #sfr, _v); \
        PKC_SFR_BASE->PKC_SFR_NAME(sfr) = _v; \
    } while (0)

#undef MCUXCLPKC_SFR_BITVALSET
#define MCUXCLPKC_SFR_BITVALSET(sfr, bit, val) \
    do { \
        uint32_t _t = PKC_SFR_BASE->PKC_SFR_NAME(sfr) \
                      & (~(uint32_t)MCUXCLPKC_SFR_BITMSK(sfr, bit)); \
        uint32_t _v = _t | (((val) << MCUXCLPKC_SFR_BITPOS(sfr, bit)) \
                            & MCUXCLPKC_SFR_BITMSK(sfr, bit)); \
        els_trace_rec('P', #sfr, _v); \
        PKC_SFR_BASE->PKC_SFR_NAME(sfr) = _v; \
    } while (0)

#endif /* ELS_SFR_TRACE_H */
```

## src/els_trace.c
```c
/* Records ELS register accesses into RAM and prints them afterwards. Nothing
 * is printed while crypto is running: the UART is far slower than the engine
 * and would change the timing being observed. */
#include <zephyr/kernel.h>
#include <stdint.h>
#include <stdio.h>

#include "els_trace.h"

#define TRACE_MAX 16384

struct rec {
    const char *name;
    uint32_t val;
    char op;
};

static struct rec recs[TRACE_MAX];
static uint32_t nrec;
static int armed;

void els_trace_rec(char op, const char *name, uint32_t val)
{
    if (!armed || nrec >= TRACE_MAX) {
        return;
    }
    recs[nrec].op = op;
    recs[nrec].name = name;
    recs[nrec].val = val;
    nrec++;
}

void els_trace_arm(int on)
{
    armed = on;
}

void els_trace_mark(const char *label)
{
    els_trace_rec('M', label, 0);
}

void els_trace_dump(void)
{
    uint32_t i;

    printk("TRACE-BEGIN %u\n", (unsigned)nrec);
    for (i = 0; i < nrec; ++i) {
        if (recs[i].op == 'M') {
            printk("M %s\n", recs[i].name);
        }
        else {
            printk("%c %s %08x\n", recs[i].op, recs[i].name,
                   (unsigned)recs[i].val);
        }
    }
    printk("TRACE-END\n");
}
```

## src/els_trace.h
```c
#ifndef ELS_TRACE_H
#define ELS_TRACE_H
#include <stdint.h>
void els_trace_rec(char op, const char *name, uint32_t val);
void els_trace_arm(int on);
void els_trace_mark(const char *label);
void els_trace_dump(void);
#endif
```
