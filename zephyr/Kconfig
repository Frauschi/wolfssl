## zephyr/Kconfig
```kconfig
# Kconfig - Cryptography primitive options for wolfSSL

#
# Copyright (c) 2016 Intel Corporation
#
# Licensed under the Apache License, Version 2.0 (the "License");
# you may not use this file except in compliance with the License.
# You may obtain a copy of the License at
#
#     http://www.apache.org/licenses/LICENSE-2.0
#
# Unless required by applicable law or agreed to in writing, software
# distributed under the License is distributed on an "AS IS" BASIS,
# WITHOUT WARRANTIES OR CONDITIONS OF ANY KIND, either express or implied.
# See the License for the specific language governing permissions and
# limitations under the License.
#

config ZEPHYR_WOLFSSL_MODULE
        bool
config WOLFSSL_PROMPTLESS
        bool
        help
          Symbol to disable the prompt for WOLFSSL selection.
          This symbol may be used internally in a Kconfig tree to hide the
          wolfSSL menu prompt and instead handle the selection of WOLFSSL from
          dependent sub-configurations and thus prevent stuck symbol behavior.


menuconfig WOLFSSL
	bool "wolfSSL Support" if !WOLFSSL_PROMPTLESS
	help
	  This option enables the wolfSSL cryptography library.

if WOLFSSL

choice WOLFSSL_IMPLEMENTATION
	prompt "Select implementation"
	default WOLFSSL_BUILTIN

config WOLFSSL_BUILTIN
	bool "Enable wolfSSL integrated sources"
	help
	  Link with local wolfSSL sources instead of external library.

config WOLFSSL_LIBRARY
	bool "Enable wolfSSL external library"
	help
	  This option enables wolfSSL library.

endchoice

config WOLFSSL_SETTINGS_FILE
	string "wolfSSL settings file"
	depends on WOLFSSL_BUILTIN
	help
	  Use a specific wolfSSL settings file. The default config file
	  file can be tweaked with Kconfig. The default settings is
	  suitable to communicate with majority of HTTPS servers on the Internet,
	  but has relatively many features enabled. To optimize resources for
	  special TLS usage, use available Kconfig settings, or select an
	  alternative config.

config WOLFSSL_HAS_SETTINGS_FILE
	bool
	default y if WOLFSSL_SETTINGS_FILE != ""
	help
	  Set when the application supplies its own wolfSSL settings file.
	  That file is authoritative - the module's user_settings.h is not
	  consulted at all - so every option below that works by writing a
	  define into user_settings.h is meaningless and depends on this being
	  clear. Options that drive the build system rather than the wolfCrypt
	  configuration stay available either way.

rsource "Kconfig.tls-generic"

config WOLFCRYPT_FIPS
	bool "wolfCrypt FIPS support"
	depends on WOLFSSL_BUILTIN
	help
	  Enable the wolfCrypt FIPS 140-3 module boundary. Requires the wolfSSL
	  FIPS bundle (fips.c, fips_test.c, wolfcrypt_first.c, wolfcrypt_last.c)
	  dropped into wolfcrypt/src/ - the CMake FIPS-boundary block compiles them.
	  Select the version that matches the bundle under "wolfCrypt FIPS version".

choice
	prompt "wolfCrypt FIPS version"
	depends on WOLFCRYPT_FIPS
	default WOLFCRYPT_FIPS_V6
	help
	  Select the FIPS module version. It must match the dropped-in bundle: the
	  in-core integrity check and the in-boundary algorithm set are keyed to the
	  version, so a mismatch fails the power-on self test. Values mirror
	  configure.ac's --enable-fips=VERSION mapping.

config WOLFCRYPT_FIPS_V2
	bool "FIPS 140-2 (Cert #3389)"
	depends on !WOLFSSL_HAS_SETTINGS_FILE
	help
	  Legacy FIPS 140-2 validated module (HAVE_FIPS_VERSION 2.0.0).

config WOLFCRYPT_FIPS_V5
	bool "FIPS 140-3 (Cert #4718)"
	depends on !WOLFSSL_HAS_SETTINGS_FILE
	help
	  wolfCrypt FIPS 140-3 validated module, Certificate #4718 (version 5.2.1).

config WOLFCRYPT_FIPS_V6
	bool "FIPS 140-3 (SRTP-KDF full submission)"
	depends on !WOLFSSL_HAS_SETTINGS_FILE
	help
	  wolfCrypt FIPS 140-3 SRTP-KDF full submission (version 6.0.0).

config WOLFCRYPT_FIPS_V7
	bool "FIPS 140-3 (v7 full submission)"
	depends on !WOLFSSL_HAS_SETTINGS_FILE
	help
	  wolfCrypt FIPS 140-3 v7 full submission (version 7.0.0).

config WOLFCRYPT_FIPS_READY
	bool "FIPS Ready (in-tree, uncertified)"
	depends on !WOLFSSL_HAS_SETTINGS_FILE
	help
	  FIPS-Ready in-tree sources, feature locked (version 8.0.0 - kept one ahead
	  of the latest submission). Carries the newest in-boundary algorithms but is
	  not yet NIST-certified; use it for pre-certification integration.

endchoice

config WOLFSSL_ELS_PKC
	bool "NXP EdgeLock (ELS) hardware offload"
	depends on WOLFSSL_BUILTIN && !WOLFSSL_HAS_SETTINGS_FILE
	depends on MCUX_ELS_PKC && !BUILD_WITH_TFM
	depends on SOC_SERIES_RW6XX
	help
	  Route wolfCrypt operations to the on-chip EdgeLock secure subsystem
	  through the crypto callback interface. Operations the hardware does
	  not implement fall back to software.

	  A settings-file build turns the port on by defining WOLFSSL_ELS_PKC
	  itself, since these options only write the module's user_settings.h.
	  Keep CONFIG_MCUX_ELS_PKC=y either way: it is what puts the vendor
	  headers on the include path.

	  Not selectable in a TF-M build, where els_pkc does not create its
	  McuxElsPkc CMake target.

	  Restricted to RW6XX because els_pkc exports src/platforms/<soc>, where
	  mcux_els.h lives, only under CONFIG_SOC_SERIES_RW6XX.

config WOLFSSL_CRYPTO_ONLY
	bool "Build wolfCrypt only (no TLS layer)"
	depends on !WOLFSSL_HAS_SETTINGS_FILE
	depends on WOLFSSL_BUILTIN
	help
	  Define WOLFCRYPT_ONLY: compile only the wolfCrypt crypto library and
	  leave the wolfSSL TLS layer out of the build.

config WOLFSSL_SINGLE_THREADED
	bool "wolfCrypt single-threaded"
	depends on !WOLFSSL_HAS_SETTINGS_FILE
	depends on WOLFSSL_BUILTIN
	default y if !MULTITHREADING
	help
	  Define SINGLE_THREADED: build wolfCrypt without internal locking, for a
	  single-threaded system or when the caller serializes all access. Defaults
	  on when the kernel has no threading (!MULTITHREADING), so consumers such
	  as wolfPSA do not need to select it themselves.

config WOLFSSL_DTLS
  bool "wolfSSL DTLS support"
  depends on !WOLFSSL_HAS_SETTINGS_FILE
  help
    Enable DTLS support

config WOLFSSL_ALPN
  bool "wolfSSL ALPN support"
  depends on !WOLFSSL_HAS_SETTINGS_FILE
  help
    Enable ALPN support

config WOLFSSL_PSK
  bool "wolfSSL PSK support"
  depends on !WOLFSSL_HAS_SETTINGS_FILE
  help
    Enable PSK support

config WOLFSSL_MLKEM
  bool "wolfSSL PQC ML-KEM support"
  depends on !WOLFSSL_HAS_SETTINGS_FILE
  help
    Enable PQC ML-KEM support for Key Exchange

config WOLFSSL_MLDSA
  bool "wolfSSL PQC ML-DSA support"
  depends on !WOLFSSL_HAS_SETTINGS_FILE
  help
    Enable PQC ML-DSA (Dilithium) signatures.

config WOLFSSL_LMS
  bool "wolfSSL LMS/HSS hash-based signatures"
  depends on !WOLFSSL_HAS_SETTINGS_FILE
  help
    Enable LMS/HSS stateful hash-based signature verification (verify-only).

config WOLFSSL_XMSS
  bool "wolfSSL XMSS/XMSS^MT hash-based signatures"
  depends on !WOLFSSL_HAS_SETTINGS_FILE
  help
    Enable XMSS/XMSS^MT stateful hash-based signature verification (verify-only).

config WOLFSSL_FALCON
  bool "wolfSSL PQC Falcon signatures"
  depends on !WOLFSSL_HAS_SETTINGS_FILE
  help
    Enable PQC Falcon (FN-DSA) signatures.

config WOLFSSL_RSA
  bool "wolfCrypt RSA support"
  depends on !WOLFSSL_HAS_SETTINGS_FILE
  default y
  help
    Enable RSA (define RSA support; NO_RSA when off).

config WOLFSSL_ECC
  bool "wolfCrypt ECC support"
  depends on !WOLFSSL_HAS_SETTINGS_FILE
  default y
  help
    Enable ECC (HAVE_ECC). At least one curve must be selected below - a
    build with none is rejected, because wolfCrypt has no curve table to
    size its types from.

if WOLFSSL_ECC

config WOLFSSL_ECC_192
  bool "SECP192R1 (P-192)"
  help
    Enable the NIST P-192 curve (HAVE_ECC192). SP math has no implementation
    at this size, so selecting it forces the generic SP variant.

    P-192 is below every current recommendation and is offered for
    interoperability with existing deployments only. Selecting it also lowers
    WOLFSSL_ECC_MIN_KEY_SZ to 192, because wolfCrypt filters curves smaller
    than that minimum out of its curve table and the option would otherwise
    appear to do nothing.

config WOLFSSL_ECC_224
  bool "SECP224R1 (P-224)"
  help
    Enable the NIST P-224 curve (HAVE_ECC224). SP math has no implementation
    at this size, so selecting it forces the generic SP variant.

config WOLFSSL_ECC_256
  bool "SECP256R1 (P-256)"
  default y
  help
    Enable the NIST P-256 curve. This is the curve TLS uses by default and
    the only one the NXP EdgeLock key store can hold, so leave it on unless
    you know the whole application avoids it.

config WOLFSSL_ECC_384
  bool "SECP384R1 (P-384)"
  help
    Enable the NIST P-384 curve (HAVE_ECC384 and the SP implementation
    behind WOLFSSL_SP_384).

    Enabling a curve larger than P-256 raises MAX_ECC_BYTES, so every ECC
    key, signature buffer and temporary grows accordingly - including on the
    stack. Size thread stacks for the largest curve selected.

config WOLFSSL_ECC_320
  bool "320-bit curves"
  help
    Enable the 320-bit curve size (HAVE_ECC320). There is no NIST curve at
    this size - it exists for brainpoolP320r1, so it is only useful together
    with WOLFSSL_ECC_BRAINPOOL.

    SP math has no implementation at this size, so selecting it moves the
    build onto the generic variant; see WOLFSSL_ECC_KOBLITZ for what that
    costs.

config WOLFSSL_ECC_512
  bool "512-bit curves"
  help
    Enable the 512-bit curve size (HAVE_ECC512). As with WOLFSSL_ECC_320
    there is no NIST curve at this size; it exists for brainpoolP512r1, and
    it likewise forces the generic SP variant.

config WOLFSSL_ECC_521
  bool "SECP521R1 (P-521)"
  help
    Enable the NIST P-521 curve (HAVE_ECC521 and the SP implementation
    behind WOLFSSL_SP_521). This sets the largest MAX_ECC_BYTES of any
    supported curve.

    Its SP implementation is also the most stack-hungry: a thread signing on
    P-521 overflowed a 16 KB stack during bring-up and needed roughly three
    times that. Raise CONFIG_MAIN_STACK_SIZE and any relevant thread stack
    accordingly.

config WOLFSSL_ECC_KOBLITZ
  bool "Koblitz curves (secp224k1, secp256k1)"
  select WOLFSSL_ECC_521
  help
    Enable the Koblitz curve variants (HAVE_ECC_KOBLITZ), including
    secp256k1.

    Each Koblitz curve additionally requires its matching size to be
    enabled: secp256k1 needs WOLFSSL_ECC_256 and secp224k1 needs
    WOLFSSL_ECC_224. Selecting this alone adds nothing. The 160-bit and
    192-bit Koblitz curves are not reachable from this menu, which offers no
    160-bit size and filters 192 out through WOLFSSL_ECC_MIN_KEY_SZ.

    Implies WOLFSSL_CUSTOM_CURVES, which wolfCrypt requires for any
    non-prime-field curve.

    Selects WOLFSSL_ECC_521 to lift wolfCrypt's bignum ceiling. Every curve in
    this family lands exactly on a 64-bit digit boundary, and the generic path
    needs more than the modulus for its intermediates, so an exact fit fails at
    runtime with a key-size error. The ceiling comes from MAX_ECC_BITS_NEEDED,
    computed from the enabled HAVE_ECCxxx set alone, so no other knob raises
    it. The cost is P-521's MAX_ECC_BITS and stack appetite, build-wide.

config WOLFSSL_ECC_BRAINPOOL
  bool "Brainpool curves"
  select WOLFSSL_ECC_521
  help
    Enable the Brainpool curve family (HAVE_ECC_BRAINPOOL). As with the
    Koblitz curves, each one also needs its matching size enabled, and this
    likewise implies WOLFSSL_CUSTOM_CURVES.

    brainpoolP256r1 needs WOLFSSL_ECC_256, brainpoolP320r1 needs
    WOLFSSL_ECC_320, brainpoolP384r1 needs WOLFSSL_ECC_384 and
    brainpoolP512r1 needs WOLFSSL_ECC_512. The 320 and 512 sizes exist for
    these curves alone.

    Selects WOLFSSL_ECC_521 for the same reason, and at the same cost, as
    WOLFSSL_ECC_KOBLITZ above.

config WOLFSSL_ECC_MIN_KEY_SZ
  int "Minimum accepted ECC key size (bits)"
  default 192 if WOLFSSL_ECC_192
  default 224
  range 112 520
  help
    Sets WOLFSSL_MIN_ECC_BITS. This has two effects, and the second is easy
    to miss.

    It drops any curve smaller than this from wolfCrypt's table, so it must
    be no larger than the smallest curve enabled above or that curve silently
    disappears.

    It is also the minimum ECC key the TLS layer will accept from a peer, so
    lowering it widens which peer certificates the stack considers
    acceptable - a security decision, not just a curve-availability one.

    Must be a multiple of 8; wolfSSL rejects anything else with a hard build
    error from inside internal.h. The range stops short of 521 for that
    reason - P-521 keys are accepted under a 520-bit minimum.

endif # WOLFSSL_ECC

config WOLFSSL_CHACHA_POLY
  bool "wolfCrypt ChaCha20-Poly1305 support"
  depends on !WOLFSSL_HAS_SETTINGS_FILE
  default y
  help
    Enable ChaCha20 and Poly1305 (HAVE_CHACHA, HAVE_POLY1305).

config WOLFSSL_CURVE25519
  bool "wolfCrypt Curve25519 / Ed25519 support"
  depends on !WOLFSSL_HAS_SETTINGS_FILE
  default n
  help
    Enable Curve25519 and Ed25519 (HAVE_CURVE25519, HAVE_ED25519).

config WOLFSSL_SNI
  bool "wolfSSL Server Name Indication (SNI)"
  depends on !WOLFSSL_HAS_SETTINGS_FILE
  default y
  help
    Enable TLS Server Name Indication (HAVE_SNI).

config WOLFSSL_SESSION_CACHE
  bool "wolfSSL TLS session cache"
  depends on !WOLFSSL_HAS_SETTINGS_FILE
  default y
  help
    Enable the TLS session cache (SMALL_SESSION_CACHE; NO_SESSION_CACHE off).

config WOLFSSL_SESSION_TICKET
  bool "wolfSSL TLS session tickets"
  depends on !WOLFSSL_HAS_SETTINGS_FILE
  default y
  help
    Enable TLS session tickets (HAVE_SESSION_TICKET, TLS 1.3 resumption).

config WOLFSSL_MAX_FRAGMENT_LEN
  int
  depends on !WOLFSSL_HAS_SETTINGS_FILE
  default 3
  range 1 6
  help
    Sets the maximum fragment length wolfSSL will use, values 1-6 correspond to enum values
    WOLFSSL_MFL_* in ssl.h

config WOLFSSL_SESSION_EXPORT
  bool "wolfSSL session export support"
  depends on !WOLFSSL_HAS_SETTINGS_FILE
  help
    Enable external session cache (HAVE_EXT_CACHE)

config WOLFSSL_KEEP_PEER_CERT
  bool "wolfSSL keep peer certificate support"
  depends on !WOLFSSL_HAS_SETTINGS_FILE
  help
    Retain peer certificate after handshake (KEEP_PEER_CERT)

config WOLFSSL_ALWAYS_VERIFY_CB
  bool "wolfSSL always invoke verify callback"
  depends on !WOLFSSL_HAS_SETTINGS_FILE
  help
    Invoke verify callback on success as well as failure (WOLFSSL_ALWAYS_VERIFY_CB)

config WOLFSSL_OPENSSL_EXTRA_X509_SMALL
  bool "wolfSSL minimal X509 compat APIs"
  depends on !WOLFSSL_HAS_SETTINGS_FILE
  help
    Define OPENSSL_EXTRA_X509_SMALL. Exposes a small subset of X509
    helpers (wolfSSL_X509_free, wolfSSL_get_verify_result, ...) without
    the rest of OPENSSL_EXTRA.

config WOLFCRYPT_ARMASM
	bool "wolfCrypt ARM Assembly support"
	depends on WOLFSSL_BUILTIN
	help
	  wolfCrypt ARM (ARMv8/ARMv7) assembly support for AES, SHA-2, SHA-3,
	  ChaCha20/Poly1305 and Curve25519

config WOLFCRYPT_ARMASM_THUMB2
	bool "wolfCrypt ARM Thumb2 Assembly support"
	depends on WOLFCRYPT_ARMASM
	help
	  Enable Thumb2 assembly optimizations for ARM processors

config WOLFCRYPT_INTELASM
	bool "wolfCrypt Intel Assembly support"
	depends on WOLFSSL_BUILTIN
	help
	  wolfCrypt Intel Aassembly support (AVX/AVX2/AESNI)

config WOLFSSL_NO_HAVE_MIN_MAX
	bool "Force wolfSSL to use its own min/max"
	help
	  Disable this if Zephyr min()/max() macros cause
	  issues. By default wolfSSL defers to Zephyr's
	  min/max on >= 4.3.

config WOLFSSL_DEBUG
	bool "wolfSSL debug activation"
	depends on WOLFSSL_BUILTIN
	help
	  Enable debugging activation for wolfSSL configuration. If you use
	  wolfSSL/Zephyr integration (e.g. net_app), this will activate debug
	  logging (of the level configured by WOLFSSL_DEBUG_LEVEL).

config WOLFSSL_INSTALL_PATH
	string "wolfSSL install path"
	depends on WOLFSSL_LIBRARY
	help
	  This option holds the path where the wolfSSL libraries and headers are
	  installed. Make sure this option is properly set when WOLFSSL_LIBRARY
	  is enabled otherwise the build will fail.

module = WOLFSSL
module-str = wolfssl
source "subsys/logging/Kconfig.template.log_config"

config APP_LINK_WITH_WOLFSSL
	bool "Link 'app' with WOLFSSL"
	default y
	help
	  Add WOLFSSL header files to the 'app' include path. It may be
	  disabled if the include paths for WOLFSSL are causing aliasing
	  issues for 'app'.

endif
```
